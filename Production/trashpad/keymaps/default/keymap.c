#include QMK_KEYBOARD_H

enum layers {
    _BASE,
    _NAV,
    _MEDIA
};

bool key_state[9] = {0};

uint8_t volume = 33;
bool show_volume_ui = false;
bool muted = false;

uint32_t last_interaction = 0;

char time_str[6] = "00:00";
char date_str[11] = "00/00/0000";

static uint8_t key_index(uint16_t keycode) {
    if (keycode >= KC_1 && keycode <= KC_9) return keycode - KC_1;
    return 255;
}

static const unsigned char PROGMEM image_icon_square_bits[] = {
    0xff,0xff,0xff,0xff,0xff,0xff,0xf9,0xff,0xf9,0xff,0xf9,0xff,0xf9,0x1f,
    0xf8,0x1f,0xf8,0x9f,0xf9,0x9f,0xf9,0x9f,0xf9,0x9f,0xf9,0x9f,0xff,0xff,
    0xff,0xff,0xff,0xff
};

static const unsigned char PROGMEM image_volume_no_sound_bits[] = {
    0xc0,0x00,0xfc,0x00,0x00,0xc0,0x00,0xfc,0x00,0x00,0x30,0x03,0x0c,0x00,
    0x00,0x30,0x03,0x0c,0x00,0x00,0x0c,0x0c,0x0c,0x00,0x00,0x0c,0x0c,0x0c,
    0x00,0x00,0x03,0x30,0x0c,0x00,0x00,0x03,0x30,0x0c,0x00,0x00,0x3f,0xc0,
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    0x00,0x00,0x00,0x00,0x00,0x00
};

static const unsigned char PROGMEM image_volume_low_bits[] = {
    0x00,0x03,0xf0,0x00,0x00,0x00,0x03,0xf0,0x00,0x00,0x00,0x0c,0x30,0x00,
    0x00,0x00,0x0c,0x30,0x00,0x00,0x00,0x30,0x30,0x00,0x00,0x00,0x30,0x30,
    0x00,0x00,0x00,0xc0,0x30,0x00,0x00,0x00,0xc0,0x30,0x00,0x00,0xff,0x00,
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    0x00,0x03,0xf0,0x00,0x00,0x00,0x00,0x00,0x00,0x00,0x00,0x00,0x00,0x00
};

static const unsigned char PROGMEM image_volume_normal_bits[] = {
    0x00,0x03,0xf0,0x00,0x00,0x00,0x03,0xf0,0x00,0x00,0x00,0x0c,0x30,0x00,
    0x00,0x00,0x0c,0x30,0x00,0x00,0x00,0x30,0x30,0x0c,0x00,0x00,0x30,0x30,
    0x0c,0x00,0x00,0xc0,0x30,0x03,0x00,0x00,0xc0,0x30,0x03,0x00,0xff,0x00,
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    0x00,0x03,0xf0,0x00,0x00,0x00,0x03,0xf0,0x00,0x00,0x00,0x00,0x00,0x00
};

static const unsigned char PROGMEM image_volume_loud_bits[] = {
    0x00,0x03,0xf0,0x03,0x00,0x00,0x03,0xf0,0x03,0x00,0x00,0x0c,0x30,0x00,
    0xc0,0x00,0x0c,0x30,0x00,0xc0,0x00,0x30,0x30,0x30,0x30,0x00,0x30,0x30,
    0x30,0x30,0x00,0xc0,0x30,0x0c,0x0c,0x00,0xc0,0x30,0x0c,0x0c,0xff,0x00,
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    0x00,0x03,0xf0,0x03,0x00,0x00,0x03,0xf0,0x03,0x00,0x00,0x00,0x00,0x00
};

static const unsigned char PROGMEM image_volume_3_bars_bits[] = {
    0x00,0x03,0xf0,0x03,0x00,0x00,0x03,0xf0,0x03,0x00,0x00,0x0c,0x30,0x0f,
    0xc0,0x00,0x0c,0x30,0x0f,0xc0,0x00,0x30,0x30,0x33,0xf0,0x00,0x30,0x30,
    0x33,0xf0,0x00,0xc0,0x30,0xfc,0xfc,0x00,0xc0,0x30,0xfc,0xfc,0xff,0x00,
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    0x00,0x03,0xf0,0x03,0x00,0x00,0x00,0x00,0x00
};

const uint16_t PROGMEM keymaps[][MATRIX_ROWS][MATRIX_COLS] = {

[_BASE] = LAYOUT(
    KC_1,    KC_2,    KC_3,
    KC_4,    KC_5,    KC_6,
    KC_7,    KC_8,    KC_9
),

[_NAV] = LAYOUT(
    KC_ESC,  KC_UP,   KC_DEL,
    KC_LEFT, KC_DOWN, KC_RGHT,
    KC_HOME, KC_END,  KC_ENT
),

[_MEDIA] = LAYOUT(
    KC_MPRV, KC_MPLY, KC_MNXT,
    KC_VOLU, KC_MUTE, KC_VOLD,
    _______, _______, _______
)

};

void update_time_from_host(const char *t, const char *d) {
    strncpy(time_str, t, sizeof(time_str) - 1);
    strncpy(date_str, d, sizeof(date_str) - 1);
    time_str[sizeof(time_str) - 1] = '\0';
    date_str[sizeof(date_str) - 1] = '\0';
}

bool process_record_user(uint16_t keycode, keyrecord_t *record) {
    uint8_t idx = key_index(keycode);
    if (idx < 9) key_state[idx] = record->event.pressed;
    return true;
}

bool encoder_update_user(uint8_t index, bool clockwise) {
    if (index == 0) {
        if (clockwise) {
            if (volume <= 97) volume += 3;
            else volume = 100;
        } else {
            if (volume >= 3) volume -= 3;
            else volume = 0;
        }
        show_volume_ui = true;
        last_interaction = timer_read32();
    }
    return false;
}

bool encoder_click_user(uint8_t index) {
    if (index == 0) {
        muted = !muted;
        tap_code(KC_MUTE);
        show_volume_ui = true;
        last_interaction = timer_read32();
    }
    return false;
}

void keyboard_post_init_user(void) {
    update_time_from_host("12:45", "16/06/2026");
}

void housekeeping_task_user(void) {
    if (show_volume_ui && timer_elapsed32(last_interaction) > 2000) {
        show_volume_ui = false;
    }
}

#ifdef OLED_ENABLE

oled_rotation_t oled_init_user(oled_rotation_t rotation) {
    return OLED_ROTATION_0;
}

static uint8_t volume_state(void) {
    if (volume == 0) return 4;
    if (volume <= 33) return 0;
    if (volume <= 66) return 1;
    if (volume <= 99) return 2;
    return 3;
}

static void render_idle(void) {
    oled_clear();

    oled_set_cursor(3, 0);
    oled_write_P(PSTR("TRASHPAD"), false);

    oled_write_raw_P(image_icon_square_bits, sizeof(image_icon_square_bits));

    for (int i = 0; i < 9; i++) {
        int col = i % 3;
        int row = i / 3;
        int px = 89 + col * 12;
        int py = 22 + row * 12;

        for (int dy = 0; dy < 8; dy++) {
            for (int dx = 0; dx < 8; dx++) {
                bool on_border = (dx == 0 || dx == 7 || dy == 0 || dy == 7);
                bool filled = key_state[i];
                if (filled || on_border) {
                    oled_write_pixel(px + dx, py + dy, true);
                }
            }
        }
    }

    oled_set_cursor(0, 5);
    oled_write(time_str, false);

    oled_set_cursor(0, 7);
    oled_write(date_str, false);
}

static void render_volume(void) {
    oled_clear();

    oled_set_cursor(3, 0);
    oled_write_P(PSTR("TRASHPAD"), false);

    if (muted) {
        oled_write_raw_P(image_volume_no_sound_bits, sizeof(image_volume_no_sound_bits));
        oled_set_cursor(10, 5);
        oled_write_P(PSTR("MUTED"), false);
    } else {
        uint8_t vs = volume_state();

        if (vs == 0) oled_write_raw_P(image_volume_low_bits, sizeof(image_volume_low_bits));
        else if (vs == 1) oled_write_raw_P(image_volume_normal_bits, sizeof(image_volume_normal_bits));
        else if (vs == 2) oled_write_raw_P(image_volume_loud_bits, sizeof(image_volume_loud_bits));
        else oled_write_raw_P(image_volume_3_bars_bits, sizeof(image_volume_3_bars_bits));

        oled_set_cursor(10, 5);
        char vol_text[4];
        itoa(volume, vol_text, 10);
        oled_write(vol_text, false);
    }
}

bool oled_task_user(void) {
    if (show_volume_ui) render_volume();
    else render_idle();
    return false;
}

#endif